## config/drivers/Kconfig
```kconfig
config GPIO_PCA9557
	bool "PCA9557 I2C GPIO expander"
	default y
	depends on DT_HAS_NXP_PCA9557_ENABLED && I2C && GPIO
	help
	  Enable driver for NXP PCA9557 8-bit I2C GPIO expander.
	  Register layout is identical to PCA9534 and TCA6408A.
```

## config/drivers/gpio/Kconfig
```kconfig
config GPIO_PCF8574
	bool "PCF8574 I2C GPIO expander"
	default y
	depends on DT_HAS_STITCHKEYS_PCF8574_ENABLED && I2C && GPIO
	help
	  Enable driver for PCF8574 8-bit I2C GPIO expander.
	  Quasi-bidirectional I/O: write 1 to use a pin as input,
	  write 0 to drive it low. No register addressing needed.
```

## config/dts/bindings/behaviors/stitchkeys,dynamic-key.yaml
```yaml
description: Dynamic runtime-configurable key behavior
compatible: "stitchkeys,dynamic-key"
properties:
  "#binding-cells":
    type: int
    required: true
    const: 1
```

## config/dts/bindings/gpio/nxp,pca9557.yaml
```yaml
description: NXP PCA9557 8-bit I2C GPIO expander

compatible: "nxp,pca9557"

include:
  - name: gpio-controller.yaml
  - name: i2c-device.yaml

gpio-cells:
  - pin
  - flags
```

## config/dts/bindings/gpio/stitchkeys,pcf8574.yaml
```yaml
description: PCF8574 8-bit I2C GPIO expander (quasi-bidirectional I/O)

compatible: "stitchkeys,pcf8574"

include:
  - name: gpio-controller.yaml
  - name: i2c-device.yaml

gpio-cells:
  - pin
  - flags
```
